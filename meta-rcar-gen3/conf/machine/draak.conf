## meta-rcar-gen3/conf/machine/draak.conf
```bitbake
#@TYPE: Machine
#@NAME: Draak machine
#@DESCRIPTION: Machine configuration for running Draak

SOC_FAMILY = "r8a77995"

DEFAULTTUNE ?= "cortexa57-cortexa53"
require conf/machine/include/tune-cortexa57-cortexa53.inc
require conf/machine/include/${SOC_FAMILY}.inc

# 32BIT package install (default is disable)
# This variables can be used only in multilib.
USE_32BIT_PKGS ?= "0"
USE_32BIT_WAYLAND ?= "0"
USE_32BIT_MMP ?= "0"

MACHINE_FEATURES = ""

KERNEL_IMAGETYPE = "Image"
IMAGE_FSTYPES_append = " tar.bz2 ext4"

SERIAL_CONSOLE = "115200 ttySC0"

# Configuration for kernel
PREFERRED_PROVIDER_virtual/kernel = "linux-renesas"
KERNEL_DEVICETREE = "renesas/r8a77995-draak.dtb"

# Configuration for ARM Trusted Firmware
EXTRA_IMAGEDEPENDS += " arm-trusted-firmware "

# u-boot
PREFERRED_VERSION_u-boot = "v2018.07%"
EXTRA_IMAGEDEPENDS += " u-boot"
UBOOT_MACHINE = "r8a77995_draak_defconfig"

# libdrm
PREFERRED_VERSION_libdrm = "2.4.85"

# Add variable to Build Configuration in build log
BUILDCFG_VARS_append = " SOC_FAMILY"

MACHINEOVERRIDES .= ":draak"
```

## meta-rcar-gen3/recipes-bsp/update/files/update-optee.its
```
/dts-v1/;

/ {
	description = "Update fitImage for #{MACHINE}";

	images {
		bootparam {
			description = "Bootparam SA0";
			data = /incbin/("bootparam_sa0-#{MACHINE}.bin");
			type = "standalone";
			os = "Bootparams SA0";
			arch = "arm64";
			compression = "none";
			load = <0x8000000>;
		};

		bl2 {
			description = "BL2";
			data = /incbin/("bl2-#{MACHINE}.bin");
			type = "standalone";
			os = "bl2";
			arch = "arm64";
			compression = "none";
			load = <0x8040000>;
		};

		certheader {
			description = "Cert Header SA6";
			data = /incbin/("cert_header_sa6-#{MACHINE}.bin");
			type = "standalone";
			os = "Cert Header SA6";
			arch = "arm64";
			compression = "none";
			load = <0x8180000>;
		};

		bl31 {
			description = "BL31";
			data = /incbin/("bl31-#{MACHINE}.bin");
			type = "standalone";
			os = "bl31";
			arch = "arm64";
			compression = "none";
			load = <0x81c0000>;
		};

		tee {
			description = "Tee";
			data = /incbin/("tee-#{MACHINE}.bin");
			type = "standalone";
			os = "tee";
			arch = "arm64";
			compression = "none";
			load = <0x8200000>;
		};

		uboot {
			description = "U-Boot (64-bit)";
			data = /incbin/("u-boot-#{MACHINE}.bin");
			type = "standalone";
			os = "U-Boot";
			arch = "arm64";
			compression = "none";
			load = <0x8640000>;
		};
	};
};
```
